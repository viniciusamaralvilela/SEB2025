/* USER CODE BEGIN Header */
/**
  ******************************************************************************
  * @file           : main.c
  * @brief          : Main program body
  ******************************************************************************
  * @attention
  *
  * <h2><center>&copy; Copyright (c) 2025 STMicroelectronics.
  * All rights reserved.</center></h2>
  *
  * This software component is licensed by ST under BSD 3-Clause license,
  * the "License"; You may not use this file except in compliance with the
  * License. You may obtain a copy of the License at:
  *                        opensource.org/licenses/BSD-3-Clause
  *
  ******************************************************************************
  */
/* USER CODE END Header */
/* Includes ------------------------------------------------------------------*/
#include "main.h"

/* Private includes ----------------------------------------------------------*/
/* USER CODE BEGIN Includes */
#include "st7735\st7735.h"
#include <stdio.h>
/* USER CODE END Includes */

/* Private typedef -----------------------------------------------------------*/
/* USER CODE BEGIN PTD */

/* USER CODE END PTD */

/* Private define ------------------------------------------------------------*/
/* USER CODE BEGIN PD */
/* USER CODE END PD */

/* Private macro -------------------------------------------------------------*/
/* USER CODE BEGIN PM */

/* USER CODE END PM */

/* Private variables ---------------------------------------------------------*/
SPI_HandleTypeDef hspi1;

/* USER CODE BEGIN PV */
/*#define ANA_LELE_HEIGHT 24
#define ANA_LELE_WIDTH 24

// array size is 1152
static const uint16_t Ana_lele[][24*24/2] = {
  0x83ff, 0x80ff, 0x80ff, 0x80ff, 0x81ff, 0xffff, 0xffff, 0xffff, 0xffff, 0xffff, 0xffff, 0x9fdf, 0x7ed7, 0x3ecf, 0xbdb6, 0x1dbf, 0x1db7, 0xdda6, 0x1daf, 0x9fdf, 0xffff, 0xffff, 0xffff, 0xffff,
  0x80ff, 0x80ff, 0x80ff, 0x80ff, 0x80ff, 0xffff, 0xffff, 0xffff, 0xffff, 0xffff, 0x9edf, 0x1db7, 0x1db7, 0xddb6, 0x19b6, 0xd0cc, 0xb5bd, 0x1db7, 0xdd9e, 0xdda6, 0x9edf, 0xffff, 0xffff, 0xffff,
  0x80ff, 0x80ff, 0x80ff, 0x80ff, 0xcdff, 0xffff, 0xffff, 0xffff, 0xffff, 0x9edf, 0x1db7, 0x1db7, 0x39ae, 0x39b6, 0x8fcc, 0x0cc4, 0x4ec4, 0xf7bd, 0x1db7, 0xdd9e, 0xdd9e, 0x9edf, 0xffff, 0xffff,
  0x80ff, 0x80ff, 0x80ff, 0xcdff, 0xffff, 0xffff, 0xffff, 0xffff, 0x5ec7, 0xfda6, 0x1daf, 0xb6b5, 0x95ad, 0x6ec4, 0x6ecc, 0xd0cc, 0x0dc4, 0x2dc4, 0x53bd, 0x1daf, 0xdd9e, 0xdd9e, 0x9edf, 0xffff,
  0xffff, 0xffff, 0xffff, 0xffff, 0xffff, 0xffff, 0xffff, 0x1eb7, 0xdd9e, 0xfdae, 0xb6b5, 0xd6a5, 0x0cbc, 0x4ec4, 0x72d5, 0x3bf7, 0x2cc4, 0xebbb, 0xebbb, 0x32bd, 0xfda6, 0xdd9e, 0xfda6, 0x9edf,
  0xffff, 0xffff, 0xffff, 0xffff, 0xffff, 0xffff, 0x3ebf, 0xdd9e, 0xddae, 0x95bd, 0xd6a5, 0x0bbc, 0xebbb, 0x11cd, 0xffff, 0x3bf7, 0xf0cc, 0x2cbc, 0xebbb, 0xebbb, 0x12c5, 0x3ebf, 0xfda6, 0x3ebf,
  0xffff, 0xffff, 0xffff, 0xffff, 0x9fdf, 0x3ebf, 0xfda6, 0x39b6, 0x18ae, 0xf8a5, 0x2dc4, 0x0cbc, 0x6dc4, 0xffff, 0xffff, 0xffff, 0x72d5, 0xcfcc, 0x0cbc, 0xebbb, 0xebbb, 0x32d5, 0x5ec7, 0x1db7,
  0xffff, 0xffff, 0xffff, 0x9edf, 0xdd9e, 0xfda6, 0x19ae, 0x7ba6, 0x7aa6, 0x6ecc, 0x8ecc, 0xafcc, 0xffff, 0xffff, 0xffff, 0xffff, 0xffff, 0x72d5, 0xcfcc, 0xebbb, 0xebbb, 0xebbb, 0x12d5, 0x5ec7,
  0xffff, 0xffff, 0x9edf, 0xfda6, 0xdd9e, 0x18b6, 0x5aa6, 0x59a6, 0x8fcc, 0xcfcc, 0x72d5, 0xffff, 0xffff, 0xffff, 0xffff, 0xffff, 0xffff, 0xffff, 0x72d5, 0xcfcc, 0x0cbc, 0x0cbc, 0x0cc4, 0xb5e5,
  0xffff, 0x9edf, 0xfda6, 0xdda6, 0xf8b5, 0x5aa6, 0xf8ad, 0x6ecc, 0xf0cc, 0x72d5, 0xffff, 0xffff, 0xffff, 0xffff, 0xffff, 0xffff, 0xffff, 0xffff, 0xffff, 0x72d5, 0xf0cc, 0x2cc4, 0x2dc4, 0x4ecc,
  0x9edf, 0xfdae, 0xddae, 0xf7ad, 0x9b9e, 0xf7ad, 0x6ecc, 0x52d5, 0x36e6, 0xffff, 0xffff, 0xffff, 0xffff, 0xffff, 0xffff, 0xffff, 0xffff, 0xffff, 0xffff, 0xffff, 0x36e6, 0x52d5, 0x2cbc, 0x4dc4,
  0x1daf, 0xddae, 0x96bd, 0x39a6, 0x74b5, 0x8fcc, 0x72d5, 0xffff, 0xffff, 0xffff, 0xffff, 0x7def, 0x9ad6, 0x5def, 0x7def, 0x59ce, 0x59ce, 0x5def, 0x5def, 0x59ce, 0x59ce, 0x5def, 0x72d5, 0x6dc4,
  0xddbe, 0x95bd, 0xd6ad, 0x0cbc, 0x8ec4, 0x72d5, 0xffff, 0xffff, 0xffff, 0xffff, 0xffff, 0x59ce, 0x18c6, 0x38c6, 0x59ce, 0x18c6, 0x18c6, 0x18c6, 0x18c6, 0x18c6, 0x18c6, 0x18c6, 0x59ce, 0xb4cd,
  0xb6bd, 0xd7ad, 0x6ecc, 0x4dc4, 0x72d5, 0xffff, 0xffff, 0xffff, 0xffff, 0xffff, 0xffff, 0x38c6, 0x18c6, 0x18c6, 0x18c6, 0x18c6, 0x18c6, 0x18c6, 0x18c6, 0x18c6, 0x18c6, 0x18c6, 0x18c6, 0x38c6,
  0x54b5, 0x6ecc, 0x52d5, 0x36e6, 0xffff, 0xffff, 0xffff, 0xffff, 0xffff, 0xffff, 0xffff, 0x1ce7, 0x18c6, 0x9ad6, 0x18c6, 0x18c6, 0x18c6, 0x18c6, 0x18c6, 0x18c6, 0x18c6, 0x18c6, 0x18c6, 0xfbde,
  0x8fcc, 0x72d5, 0xffff, 0xffff, 0xffff, 0x7def, 0x9ad6, 0x5def, 0xffff, 0xffff, 0xffff, 0xffff, 0xffff, 0xffff, 0x1ce7, 0x18c6, 0x18c6, 0x18c6, 0x18c6, 0xfbde, 0xffff, 0xffff, 0xffff, 0xffff,
  0x72d5, 0xffff, 0xffff, 0x7def, 0x59ce, 0x38c6, 0x18c6, 0x38c6, 0xffff, 0xffff, 0xffff, 0xffff, 0xffff, 0xffff, 0xffff, 0xffff, 0xffff, 0xffff, 0xffff, 0xffff, 0xffff, 0xffff, 0xffff, 0xffff,
  0xffff, 0xffff, 0xffff, 0x59ce, 0x18c6, 0x18c6, 0x18c6, 0x18c6, 0x38c6, 0x59ce, 0x5def, 0xffff, 0xffff, 0xffff, 0xffff, 0xffff, 0xffff, 0xffff, 0xffff, 0xffff, 0xffff, 0xffff, 0xffff, 0xffff,
  0xffff, 0xffff, 0xffff, 0xdbde, 0x18c6, 0x18c6, 0x38c6, 0x38c6, 0x18c6, 0x18c6, 0x38c6, 0xffff, 0xffff, 0xffff, 0xffff, 0xffff, 0xffff, 0xffff, 0xffff, 0xffff, 0xffff, 0xffff, 0xffff, 0xffff,
  0xffff, 0xffff, 0xffff, 0x59ce, 0x18c6, 0x18c6, 0x18c6, 0x18c6, 0x18c6, 0x18c6, 0x18c6, 0xffff, 0xffff, 0xffff, 0xffff, 0xffff, 0xffff, 0xffff, 0xffff, 0xffff, 0xffff, 0xffff, 0xffff, 0xffff,
  0xffff, 0x7def, 0x59ce, 0x18c6, 0x18c6, 0x18c6, 0x18c6, 0x18c6, 0x9ad6, 0x18c6, 0xfbde, 0xffff, 0xffff, 0xffff, 0xffff, 0xffff, 0xffff, 0xffff, 0xffff, 0xffff, 0xffff, 0xffff, 0xffff, 0xffff,
  0xffff, 0x59ce, 0x18c6, 0x18c6, 0x18c6, 0x18c6, 0x18c6, 0x38c6, 0xffff, 0xffff, 0xffff, 0xffff, 0xffff, 0xffff, 0xffff, 0xffff, 0xffff, 0xffff, 0xffff, 0xffff, 0xffff, 0xffff, 0xffff, 0xffff,
  0xffff, 0x1ce7, 0x18c6, 0x18c6, 0x18c6, 0x18c6, 0x18c6, 0xfbde, 0xffff, 0xffff, 0xffff, 0xffff, 0xffff, 0xffff, 0xffff, 0xffff, 0xffff, 0xffff, 0xffff, 0xffff, 0xffff, 0xffff, 0xffff, 0xffff,
  0xffff, 0xffff, 0xffff, 0xffff, 0xffff, 0xffff, 0xffff, 0xffff, 0xffff, 0xffff, 0xffff, 0xffff, 0xffff, 0xffff, 0xffff, 0xffff, 0xffff, 0xffff, 0xffff, 0xffff, 0xffff, 0xffff, 0xffff, 0xffff
};*/
#define _2_HEIGHT 32
#define _2_WIDTH 32

// array size is 2048
static const uint16_t _2[][32*32/2] = {
  0x1d05, 0x1d05, 0x1d05, 0x1d05, 0x1d05, 0x1d05, 0x1d05, 0x1d05, 0x1d05, 0x1d05, 0x1d05, 0x1d05, 0x3d05, 0xbd35, 0xbd35, 0x3d0d, 0x1d05, 0x1d05, 0x3d05, 0xbd35, 0xdd45, 0x7d25, 0x1d05, 0x1d05, 0x1d05, 0x1d05, 0x1d05, 0x1d05, 0x1d05, 0x1d05, 0x1d05, 0x1d05,
  0x1d05, 0x1d05, 0x1d05, 0x1d05, 0x1d05, 0x1d05, 0x1d05, 0x1d05, 0x1d05, 0x1d05, 0x1d05, 0x9d2d, 0x1faf, 0xbfef, 0xbfef, 0x7e7e, 0x3d0d, 0x9d2d, 0x1faf, 0xbfef, 0xffff, 0x9fd7, 0x3d05, 0x1d05, 0x1d05, 0x1d05, 0x1d05, 0x1d05, 0x1d05, 0x1d05, 0x1d05, 0x1d05,
  0xfd4d, 0x5fc7, 0x5fcf, 0xbd35, 0x1d05, 0x1d05, 0x1d05, 0x1d05, 0x1d05, 0x1d05, 0x7d1d, 0x7fcf, 0xffff, 0xffff, 0xffff, 0xffff, 0xffff, 0xffff, 0xffff, 0xffff, 0xffff, 0xffff, 0x7fcf, 0x7d25, 0x1d05, 0x1d05, 0x1d05, 0x1d05, 0x1d05, 0x1d05, 0x1d05, 0x1d05,
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  0x8925, 0x8925, 0x8925, 0x8925, 0x8925, 0x8925, 0x8925, 0x8925, 0x8925, 0x8925, 0x8925, 0x8925, 0x8925, 0x8925, 0x8925, 0x8925, 0x8925, 0x8925, 0x8925, 0x8925, 0x8925, 0x8925, 0x8925, 0x8925, 0x8925, 0x8925, 0x8925, 0x8925, 0x8925, 0x8925, 0x8925, 0x8925
};
#define _1_HEIGHT 32
#define _1_WIDTH 32

// array size is 2048
static const uint16_t _1[][32*32/2] = {
  0xffff, 0xdff7, 0x3d05, 0x1d05, 0x1d05, 0x1d05, 0x1d05, 0x1d05, 0x1d05, 0x1d05, 0x1d05, 0x1d05, 0x1d05, 0x1d05, 0x1d05, 0x1d05, 0x1d05, 0x1d05, 0x3d05, 0xbd35, 0xdd45, 0x7d25, 0x1d05, 0x3d0d, 0xdd3d, 0xdd3d, 0x5d15, 0x1d05, 0x1d05, 0x1d05, 0x1d05, 0x1d05,
  0xffff, 0xffff, 0xdd3d, 0x3d05, 0x3d05, 0x1d05, 0x1d05, 0x1d05, 0x1d05, 0x1d05, 0x1d05, 0x1d05, 0x1d05, 0x1d05, 0x1d05, 0x3d0d, 0x1d56, 0xfea6, 0x5e76, 0xbfef, 0xffff, 0x9fd7, 0x7d1d, 0xfea6, 0xdff7, 0xdff7, 0x1faf, 0x5d1d, 0x3d05, 0x1d05, 0x1d05, 0x1d05,
  0xffff, 0xffff, 0xbfe7, 0x7fd7, 0x5fcf, 0x7d25, 0x1d05, 0x1d05, 0x1d05, 0x1d05, 0x1c05, 0x1d05, 0x1d05, 0x1d05, 0x1d05, 0x5d15, 0xdfef, 0xffff, 0xffff, 0xffff, 0xffff, 0xffff, 0xdff7, 0xffff, 0xffff, 0xffff, 0xffff, 0xffff, 0x7fcf, 0xfd4d, 0x5d15, 0x1d05,
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  0x8925, 0x8925, 0x8925, 0x8925, 0x8925, 0x8925, 0x8925, 0x8925, 0x8925, 0x8925, 0x8925, 0x8925, 0x8925, 0x8925, 0x8925, 0x8925, 0x8925, 0x8925, 0x8925, 0x8925, 0x8925, 0x8925, 0x8925, 0x8925, 0x8925, 0x8925, 0x8925, 0x8925, 0x8925, 0x8925, 0x8925, 0x8925
};
#define _3_HEIGHT 32
#define _3_WIDTH 32

// array size is 2048
static const uint16_t _3[][32*32/2] = {
  0x1d05, 0x1d05, 0xbe8e, 0xffff, 0xffff, 0xde9e, 0x3d05, 0x1d05, 0x1d05, 0x5d15, 0xbd3d, 0x7d25, 0x1d05, 0x1d05, 0x1d05, 0x1d05, 0x1d05, 0x1d05, 0x1d05, 0x1d05, 0x1d05, 0x3d0d, 0x3d05, 0xbd35, 0xdd45, 0xbd3d, 0x5d15, 0x1d05, 0x7d1d, 0xdd45, 0xdd45, 0x7d25,
  0x1d05, 0x3d0d, 0xdff7, 0xffff, 0xffff, 0xffff, 0x3fbf, 0x3e66, 0x3d05, 0xbe8e, 0xdff7, 0x9fd7, 0x1d05, 0x1d05, 0x3d05, 0x1d05, 0x1d05, 0x1d05, 0x1d05, 0x1d05, 0x1d05, 0x5d15, 0xbd35, 0xbfe7, 0xffff, 0xdff7, 0x7fcf, 0x1eaf, 0x7fd7, 0xffff, 0xffff, 0x9fdf,
  0x3d0d, 0x1fb7, 0xffff, 0xffff, 0xffff, 0xffff, 0xffff, 0xffff, 0xbfef, 0xdff7, 0xffff, 0xffff, 0x9e86, 0x1fb7, 0x5e6e, 0x3d0d, 0x1d05, 0x1d05, 0x1d05, 0x1d05, 0x1d05, 0x5d1d, 0xbfe7, 0xffff, 0xffff, 0xffff, 0xffff, 0xffff, 0xffff, 0xffff, 0xffff, 0xffff,
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  0x8925, 0x8925, 0x8925, 0x8925, 0x8925, 0x8925, 0x8925, 0x8925, 0x8925, 0x8925, 0x8925, 0x8925, 0x8925, 0x8925, 0x8925, 0x8925, 0x8925, 0x8925, 0x8925, 0x8925, 0x8925, 0x8925, 0x8925, 0x8925, 0x8925, 0x8925, 0x8925, 0x8925, 0x8925, 0x8925, 0x8925, 0x8925
};

/* USER CODE END PV */

/* Private function prototypes -----------------------------------------------*/
void SystemClock_Config(void);
static void MX_GPIO_Init(void);
static void MX_SPI1_Init(void);
/* USER CODE BEGIN PFP */

/* USER CODE END PFP */

/* Private user code ---------------------------------------------------------*/
/* USER CODE BEGIN 0 */

/* USER CODE END 0 */

/**
  * @brief  The application entry point.
  * @retval int
  */
int main(void)
{
  /* USER CODE BEGIN 1 */

  /* USER CODE END 1 */

  /* MCU Configuration--------------------------------------------------------*/

  /* Reset of all peripherals, Initializes the Flash interface and the Systick. */
  HAL_Init();

  /* USER CODE BEGIN Init */

  /* USER CODE END Init */

  /* Configure the system clock */
  SystemClock_Config();

  /* USER CODE BEGIN SysInit */

  /* USER CODE END SysInit */

  /* Initialize all configured peripherals */
  MX_GPIO_Init();
  MX_SPI1_Init();
  /* USER CODE BEGIN 2 */
ST7735_Init();
ST7735_FillScreen(WHITE);
  /* USER CODE END 2 */

  /* Infinite loop */
  /* USER CODE BEGIN WHILE */
  while (1)
  {
    /* USER CODE END WHILE */
	  SysTick->LOAD = 16000000;
	  ST7735_DrawImage(0, 0, 32, 32, (const uint16_t *)_2);
	  HAL_Delay(200);
	  ST7735_DrawImage(0, 0, 32, 32, (const uint16_t *)_1);
	  HAL_Delay(200);
	  ST7735_DrawImage(0, 0, 32, 32, (const uint16_t *)_3);
	  HAL_Delay(200);
    /* USER CODE BEGIN 3 */
  }
  /* USER CODE END 3 */
}

/**
  * @brief System Clock Configuration
  * @retval None
  */
void SystemClock_Config(void)
{
  RCC_OscInitTypeDef RCC_OscInitStruct = {0};
  RCC_ClkInitTypeDef RCC_ClkInitStruct = {0};

  /** Initializes the RCC Oscillators according to the specified parameters
  * in the RCC_OscInitTypeDef structure.
  */
  RCC_OscInitStruct.OscillatorType = RCC_OSCILLATORTYPE_HSI;
  RCC_OscInitStruct.HSIState = RCC_HSI_ON;
  RCC_OscInitStruct.HSICalibrationValue = RCC_HSICALIBRATION_DEFAULT;
  RCC_OscInitStruct.PLL.PLLState = RCC_PLL_ON;
  RCC_OscInitStruct.PLL.PLLSource = RCC_PLLSOURCE_HSI_DIV2;
  RCC_OscInitStruct.PLL.PLLMUL = RCC_PLL_MUL16;
  if (HAL_RCC_OscConfig(&RCC_OscInitStruct) != HAL_OK)
  {
    Error_Handler();
  }
  /** Initializes the CPU, AHB and APB buses clocks
  */
  RCC_ClkInitStruct.ClockType = RCC_CLOCKTYPE_HCLK|RCC_CLOCKTYPE_SYSCLK
                              |RCC_CLOCKTYPE_PCLK1|RCC_CLOCKTYPE_PCLK2;
  RCC_ClkInitStruct.SYSCLKSource = RCC_SYSCLKSOURCE_PLLCLK;
  RCC_ClkInitStruct.AHBCLKDivider = RCC_SYSCLK_DIV1;
  RCC_ClkInitStruct.APB1CLKDivider = RCC_HCLK_DIV2;
  RCC_ClkInitStruct.APB2CLKDivider = RCC_HCLK_DIV1;

  if (HAL_RCC_ClockConfig(&RCC_ClkInitStruct, FLASH_LATENCY_2) != HAL_OK)
  {
    Error_Handler();
  }
}

/**
  * @brief SPI1 Initialization Function
  * @param None
  * @retval None
  */
static void MX_SPI1_Init(void)
{

  /* USER CODE BEGIN SPI1_Init 0 */

  /* USER CODE END SPI1_Init 0 */

  /* USER CODE BEGIN SPI1_Init 1 */

  /* USER CODE END SPI1_Init 1 */
  /* SPI1 parameter configuration*/
  hspi1.Instance = SPI1;
  hspi1.Init.Mode = SPI_MODE_MASTER;
  hspi1.Init.Direction = SPI_DIRECTION_1LINE;
  hspi1.Init.DataSize = SPI_DATASIZE_8BIT;
  hspi1.Init.CLKPolarity = SPI_POLARITY_LOW;
  hspi1.Init.CLKPhase = SPI_PHASE_1EDGE;
  hspi1.Init.NSS = SPI_NSS_SOFT;
  hspi1.Init.BaudRatePrescaler = SPI_BAUDRATEPRESCALER_32;
  hspi1.Init.FirstBit = SPI_FIRSTBIT_MSB;
  hspi1.Init.TIMode = SPI_TIMODE_DISABLE;
  hspi1.Init.CRCCalculation = SPI_CRCCALCULATION_DISABLE;
  hspi1.Init.CRCPolynomial = 10;
  if (HAL_SPI_Init(&hspi1) != HAL_OK)
  {
    Error_Handler();
  }
  /* USER CODE BEGIN SPI1_Init 2 */

  /* USER CODE END SPI1_Init 2 */

}

/**
  * @brief GPIO Initialization Function
  * @param None
  * @retval None
  */
static void MX_GPIO_Init(void)
{
  GPIO_InitTypeDef GPIO_InitStruct = {0};

  /* GPIO Ports Clock Enable */
  __HAL_RCC_GPIOA_CLK_ENABLE();
  __HAL_RCC_GPIOB_CLK_ENABLE();

  /*Configure GPIO pin Output Level */
  HAL_GPIO_WritePin(ST7735_CS_GPIO_Port, ST7735_CS_Pin, GPIO_PIN_RESET);

  /*Configure GPIO pin Output Level */
  HAL_GPIO_WritePin(GPIOB, ST7735_DC_Pin|ST7735_RES_Pin, GPIO_PIN_RESET);

  /*Configure GPIO pin : ST7735_CS_Pin */
  GPIO_InitStruct.Pin = ST7735_CS_Pin;
  GPIO_InitStruct.Mode = GPIO_MODE_OUTPUT_PP;
  GPIO_InitStruct.Pull = GPIO_NOPULL;
  GPIO_InitStruct.Speed = GPIO_SPEED_FREQ_LOW;
  HAL_GPIO_Init(ST7735_CS_GPIO_Port, &GPIO_InitStruct);

  /*Configure GPIO pins : ST7735_DC_Pin ST7735_RES_Pin */
  GPIO_InitStruct.Pin = ST7735_DC_Pin|ST7735_RES_Pin;
  GPIO_InitStruct.Mode = GPIO_MODE_OUTPUT_PP;
  GPIO_InitStruct.Pull = GPIO_NOPULL;
  GPIO_InitStruct.Speed = GPIO_SPEED_FREQ_LOW;
  HAL_GPIO_Init(GPIOB, &GPIO_InitStruct);

}

/* USER CODE BEGIN 4 */

/* USER CODE END 4 */

/**
  * @brief  This function is executed in case of error occurrence.
  * @retval None
  */
void Error_Handler(void)
{
  /* USER CODE BEGIN Error_Handler_Debug */
  /* User can add his own implementation to report the HAL error return state */
  __disable_irq();
  while (1)
  {
  }
  /* USER CODE END Error_Handler_Debug */
}

#ifdef  USE_FULL_ASSERT
/**
  * @brief  Reports the name of the source file and the source line number
  *         where the assert_param error has occurred.
  * @param  file: pointer to the source file name
  * @param  line: assert_param error line source number
  * @retval None
  */
void assert_failed(uint8_t *file, uint32_t line)
{
  /* USER CODE BEGIN 6 */
  /* User can add his own implementation to report the file name and line number,
     ex: printf("Wrong parameters value: file %s on line %d\r\n", file, line) */
  /* USER CODE END 6 */
}
#endif /* USE_FULL_ASSERT */

/************************ (C) COPYRIGHT STMicroelectronics *****END OF FILE****/
